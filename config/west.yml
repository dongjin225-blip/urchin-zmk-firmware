## config/west.yml
```yaml
manifest:
  remotes:
    # zmk official
    - name: zmkfirmware
      url-base: https://github.com/zmkfirmware
    # zmk with battery upower 
    # - name: zmkfirmware
    #   url-base: https://github.com/eyesonly
      # bravekarma
    - name: caksoylar
      url-base: https://github.com/caksoylar
      # kyek / duckyb
    - name: duckyb
      url-base: https://github.com/duckyb
      # nice-view-gem
    - name: m165437
      url-base: https://github.com/M165437
    - name: badjeff
      url-base: https://github.com/badjeff
    - name: urob
      url-base: https://github.com/urob
    - name: eyesonly
      url-base: https://github.com/eyesonly
  projects:
    - name: zmk
      remote: zmkfirmware
      # Use the same stable ZMK release as the Crosses keyboard.  The newer
      # Zephyr 4.1 BLE stack repeatedly re-enumerates this older nice!nano as a
      # Windows HID device after a power cycle.
      revision: v0.3
      import: app/west.yml
    - name: urchin-zmk-module
      remote: duckyb
      revision: a3ab64fa7779f82675695f3d7d17f705f840da25
    - name: nice-view-gem
      remote: m165437
      revision: 0a50fe209d929c916c5664c6affd0f4977c6b012
    - name: zmk-rgbled-widget
      remote: caksoylar
      revision: e6b467792a1dabef8cfa5c9fd26bfefc9c16662b
    - name: zmk-behavior-battery-percentage-printer
      remote: badjeff
      revision: e111cbc6ac66caaa157daeb58eda3c8e2b43153a
    - name: zmk-adaptive-key
      remote: urob
      revision: e987227d625e8863343baf16bd11ff90310482a5
    - name: zmk-poor-mans-led-indicator
      remote: eyesonly
      revision: 6f9433df6291d95a7682b05e8252e1762d735e7b
self:
    path: config
```
